# file: BFMC_Sensor_401.ioc
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FREERTOS.Queues01=imu,16,uint8_t,0,Dynamic,NULL,NULL;as6500,16,uint8_t,0,Dynamic,NULL,NULL;command,16,uint8_t,0,Dynamic,NULL,NULL;response,16,uint8_t,0,Dynamic,NULL,NULL
FREERTOS.Tasks01=IMU,25,256,imu_func,Default,NULL,Dynamic,NULL,NULL;UART_TX,9,256,uart_tx_func,Default,NULL,Dynamic,NULL,NULL;QUICKRUN,41,128,quickrun_func,Default,NULL,Dynamic,NULL,NULL;Servo,41,128,servo_func,Default,NULL,Dynamic,NULL,NULL;UART_RX,41,128,uart_rx_func,Default,NULL,Dynamic,NULL,NULL;Fushion,8,128,fushion_func,Default,NULL,Dynamic,NULL,NULL
Mcu.Family=STM32F4
Mcu.Name=STM32F401R(D-E)Tx
Mcu.Package=LQFP64
NVIC.PriorityGroup=NVIC_PRIORITYGROUP_4
ProjectManager.HeapSize=0x200
ProjectManager.StackSize=0x400
ProjectManager.TargetToolchain=STM32CubeIDE
RCC.AHBFreq_Value=16000000
RCC.APB1Freq_Value=16000000
RCC.APB2Freq_Value=16000000
RCC.CortexFreq_Value=16000000
RCC.HSE_VALUE=25000000
RCC.HSI_VALUE=16000000
RCC.LSE_VALUE=32768
RCC.SYSCLKFreq_VALUE=16000000
RCC.VCOOutputFreq_Value=192000000
VP_FREERTOS_VS_CMSIS_V2.Mode=CMSIS_V2
board=custom

// file: Core/Src/main.c
/* USER CODE BEGIN Header */
/**
  ******************************************************************************
  * @file           : main.c
  * @brief          : Main program body
  ******************************************************************************
  * @attention
  *
  * Copyright (c) 2025 STMicroelectronics.
  * All rights reserved.
  *
  * This software is licensed under terms that can be found in the LICENSE file
  * in the root directory of this software component.
  * If no LICENSE file comes with this software, it is provided AS-IS.
  *
  ******************************************************************************
  */
/* USER CODE END Header */
#include "main.h"
#include "cmsis_os.h"

/* USER CODE BEGIN Includes */
#include "mydriver.h"
/* USER CODE END Includes */

/* USER CODE BEGIN PTD */
typedef struct
{
    float yaw;
    float pitch;
    float roll;
} IMU_Data_t;

/* USER CODE END PTD */

/* USER CODE BEGIN PD */
#define BNO055_CHIP_ID         0x00
#define BNO055_CHIP_ID_VAL     0xA0

/* USER CODE END PD */

/* Definitions for IMU */
osThreadId_t IMUHandle;
const osThreadAttr_t IMU_attributes = {
  .name = "IMU",
  .stack_size = 256 * 4,
  .priority = (osPriority_t) osPriorityNormal1,
};
/* Definitions for UART_TX */
osThreadId_t UART_TXHandle;
const osThreadAttr_t UART_TX_attributes = {
  .name = "UART_TX",
  .stack_size = 256 * 4,
  .priority = (osPriority_t) osPriorityLow1,
};
/* Definitions for QUICKRUN */
osThreadId_t QUICKRUNHandle;
const osThreadAttr_t QUICKRUN_attributes = {
  .name = "QUICKRUN",
  .stack_size = 128 * 4,
  .priority = (osPriority_t) osPriorityHigh1,
};
/* Definitions for Servo */
osThreadId_t ServoHandle;
const osThreadAttr_t Servo_attributes = {
  .name = "Servo",
  .stack_size = 128 * 4,
  .priority = (osPriority_t) osPriorityHigh1,
};
/* Definitions for UART_RX */
osThreadId_t UART_RXHandle;
const osThreadAttr_t UART_RX_attributes = {
  .name = "UART_RX",
  .stack_size = 128 * 4,
  .priority = (osPriority_t) osPriorityHigh1,
};
/* Definitions for Fushion */
osThreadId_t FushionHandle;
const osThreadAttr_t Fushion_attributes = {
  .name = "Fushion",
  .stack_size = 128 * 4,
  .priority = (osPriority_t) osPriorityLow,
};
/* Definitions for imu */
osMessageQueueId_t imuHandle;
const osMessageQueueAttr_t imu_attributes = {
  .name = "imu"
};
/* Definitions for as6500 */
osMessageQueueId_t as6500Handle;
const osMessageQueueAttr_t as6500_attributes = {
  .name = "as6500"
};
/* Definitions for command */
osMessageQueueId_t commandHandle;
const osMessageQueueAttr_t command_attributes = {
  .name = "command"
};
/* Definitions for response */
osMessageQueueId_t responseHandle;
const osMessageQueueAttr_t response_attributes = {
  .name = "response"
};

void SystemClock_Config(void);
void imu_func(void *argument);
void uart_tx_func(void *argument);
void quickrun_func(void *argument);
void servo_func(void *argument);
void uart_rx_func(void *argument);
void fushion_func(void *argument);

int main(void)
{

  /* MCU Configuration--------------------------------------------------------*/

  /* Reset of all peripherals, Initializes the Flash interface and the Systick. */
  HAL_Init();

  /* Configure the system clock */
  SystemClock_Config();

  /* Initialize all configured peripherals */
  /* USER CODE BEGIN 2 */
  CHI_UART_init();
  I2C1_Master_Init();

  CHI_UART_print_log("BNO055 scan...\r\n");
  uint8_t id = BNO055_ReadReg(BNO055_CHIP_ID);
  CHI_UART_print_log("CHIP_ID=");
  CHI_UART_send_number(id);
  CHI_UART_print_log("\r\n");
  if (id != BNO055_CHIP_ID_VAL) {
  	CHI_UART_print_log("BNO055 not found (addr/PS/pull-up?)\r\n");
      while(1);
  }

  CHI_UART_print_log("BNO055 init...\r\n");
  BNO055_Init();

  HAL_Delay(50);
  /* USER CODE END 2 */

  /* Init scheduler */
  osKernelInitialize();

  /* Create the queue(s) */
  /* creation of imu */
  imuHandle = osMessageQueueNew (16, sizeof(IMU_Data_t), &imu_attributes);

  /* creation of as6500 */
  as6500Handle = osMessageQueueNew (16, sizeof(uint8_t), &as6500_attributes);

  /* creation of command */
  commandHandle = osMessageQueueNew (16, sizeof(uint8_t), &command_attributes);

  /* creation of response */
  responseHandle = osMessageQueueNew (16, sizeof(uint8_t), &response_attributes);

  /* Create the thread(s) */
  /* creation of IMU */
  IMUHandle = osThreadNew(imu_func, NULL, &IMU_attributes);

  /* creation of UART_TX */
  UART_TXHandle = osThreadNew(uart_tx_func, NULL, &UART_TX_attributes);

  /* creation of QUICKRUN */
  QUICKRUNHandle = osThreadNew(quickrun_func, NULL, &QUICKRUN_attributes);

  /* creation of Servo */
  ServoHandle = osThreadNew(servo_func, NULL, &Servo_attributes);

  /* creation of UART_RX */
  UART_RXHandle = osThreadNew(uart_rx_func, NULL, &UART_RX_attributes);

  /* creation of Fushion */
  FushionHandle = osThreadNew(fushion_func, NULL, &Fushion_attributes);

  /* Start scheduler */
  osKernelStart();

  /* We should never get here as control is now taken by the scheduler */

  /* Infinite loop */
  while (1)
  {

  }
}

void SystemClock_Config(void)
{
  RCC_OscInitTypeDef RCC_OscInitStruct = {0};
  RCC_ClkInitTypeDef RCC_ClkInitStruct = {0};

  /** Configure the main internal regulator output voltage
  */
  __HAL_RCC_PWR_CLK_ENABLE();
  __HAL_PWR_VOLTAGESCALING_CONFIG(PWR_REGULATOR_VOLTAGE_SCALE2);

  /** Initializes the RCC Oscillators according to the specified parameters
  * in the RCC_OscInitTypeDef structure.
  */
  RCC_OscInitStruct.OscillatorType = RCC_OSCILLATORTYPE_HSI;
  RCC_OscInitStruct.HSIState = RCC_HSI_ON;
  RCC_OscInitStruct.HSICalibrationValue = RCC_HSICALIBRATION_DEFAULT;
  RCC_OscInitStruct.PLL.PLLState = RCC_PLL_NONE;
  if (HAL_RCC_OscConfig(&RCC_OscInitStruct) != HAL_OK)
  {
    Error_Handler();
  }

  /** Initializes the CPU, AHB and APB buses clocks
  */
  RCC_ClkInitStruct.ClockType = RCC_CLOCKTYPE_HCLK|RCC_CLOCKTYPE_SYSCLK
                              |RCC_CLOCKTYPE_PCLK1|RCC_CLOCKTYPE_PCLK2;
  RCC_ClkInitStruct.SYSCLKSource = RCC_SYSCLKSOURCE_HSI;
  RCC_ClkInitStruct.AHBCLKDivider = RCC_SYSCLK_DIV1;
  RCC_ClkInitStruct.APB1CLKDivider = RCC_HCLK_DIV1;
  RCC_ClkInitStruct.APB2CLKDivider = RCC_HCLK_DIV1;

  if (HAL_RCC_ClockConfig(&RCC_ClkInitStruct, FLASH_LATENCY_0) != HAL_OK)
  {
    Error_Handler();
  }
}

void imu_func(void *argument)
{
  /* USER CODE BEGIN 5 */
  /* Infinite loop */
    IMU_Data_t imu;

    for (;;)
    {
        int16_t ex, ey, ez;

        BNO055_ReadEuler_raw(&ex, &ey, &ez);

        imu.yaw   = ex / 16.0f;
//        imu.roll  = ey / 16.0f;
//        imu.pitch = ez / 16.0f;

        osMessageQueuePut(imuHandle, &imu, 0, 0);

        osDelay(10); // 100 Hz
    }
  /* USER CODE END 5 */
}

void uart_tx_func(void *argument)
{
  /* USER CODE BEGIN uart_tx_func */
  /* Infinite loop */
    IMU_Data_t imu;

    for (;;)
    {
        if (osMessageQueueGet(imuHandle, &imu, NULL, osWaitForever) == osOK)
        {
            CHI_UART_print_log("Yaw:");
            CHI_UART_send_float(imu.yaw);
//            CHI_UART_print_log(" Pitch:");
//            CHI_UART_send_float(imu.pitch);
//            CHI_UART_print_log(" Roll:");
//            CHI_UART_send_float(imu.roll);
//            CHI_UART_print_log("\r\n");
        }
        osDelay(100); // 100 Hz
    }

  /* USER CODE END uart_tx_func */
}

void quickrun_func(void *argument)
{
  for(;;)
  {
    osDelay(1);
  }
}

void servo_func(void *argument)
{
  for(;;)
  {
    osDelay(1);
  }
}

void uart_rx_func(void *argument)
{
    for (;;)
    {
        osDelay(1);
    }
}

void fushion_func(void *argument)
{
  for(;;)
  {
    osDelay(1);
  }
}

void Error_Handler(void)
{
  __disable_irq();
  while (1)
  {
  }
}
